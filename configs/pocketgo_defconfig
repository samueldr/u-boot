## configs/pocketgo_defconfig
```kconfig
CONFIG_ARM=y
CONFIG_ARCH_SUNXI=y
CONFIG_MACH_SUNIV=y
CONFIG_DRAM_CLK=156
CONFIG_DRAM_ZQ=0
# CONFIG_VIDEO_SUNXI is not set
CONFIG_DEFAULT_DEVICE_TREE="suniv-f1c100s-pocketgo"
CONFIG_SPL=y
# CONFIG_SPL_DM_SERIAL is not set
CONFIG_MMC_SUNXI=y
CONFIG_CONS_INDEX=2
CONFIG_NET=n
```
